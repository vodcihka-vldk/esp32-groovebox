// Auto-generated from samples/hihat_closed.wav
// 1 channel(s), 16 bits, 44100 Hz

#include <stdint.h>

const uint16_t hihat_closed_length = 4410;
const int16_t hihat_closed[4410] = {
    10315, -2403, -10665, 8466, -7482, 2471, -1324, -3732, -4601, -155, -2502, 2007, 9395, -3791, -7718, -10751, 
    2718, -4465, -3555, -336, 13199, -16048, -2788, 4762, -455, 3767, 10197, -4967, 5876, 13175, -2614, 13774, 
    -6137, -5372, -2836, -126, -10885, 2860, -121, 4044, 3811, -1189, -3557, -883, 1094, 2467, 979, -3127, 
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    196, -135, -338, 143, 231, -441, 419, -9, -547, -58
};
