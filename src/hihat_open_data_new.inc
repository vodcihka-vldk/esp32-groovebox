// Auto-generated from samples/hihat_open.wav
// 1 channel(s), 16 bits, 44100 Hz

#include <stdint.h>

const uint16_t hihat_open_length = 4410;
const int16_t hihat_open[4410] = {
    915, -3769, -4965, -5972, 1559, 2420, 7282, -1003, 487, 1406, 699, -2559, 9993, 3930, 4083, 17185, 
    3765, 5774, -686, -13582, -58, 690, 7754, -2826, 5847, -6559, 17004, 5787, 1377, 2511, 4840, -1107, 
    14357, -7640, -226, 17644, 7891, 6773, -10033, -1315, -4310, 5691, -6733, -5668, 8975, -4576, -2333, 8399, 
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    -6871, 3447, 7108, -3679, 3892, -4894, -47, -9654, -459, 8587
};
