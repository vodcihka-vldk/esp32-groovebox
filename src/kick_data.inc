// Simple test samples for ESP32 Groovebox

#include <stdint.h>

// Kick drum sample (simple sine sweep)
const uint16_t kick_data_length = 22050; // 0.5 seconds at 44.1kHz
const int16_t kick_data[] = {
    0, 983, 1966, 2948, 3929, 4908, 5885, 6860, 7832, 8802, 9768, 10731, 11690, 12644, 13592, 14534,
    15469, 16396, 17315, 18225, 19125, 20015, 20894, 21761, 22616, 23458, 24286, 25100, 25899, 26682,
    27448, 28196, 28926, 29636, 30326, 30996, 31644, 32270, 32873, 33452, 34007, 34536, 35039, 35515,
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    -198704053, -199135426, -199567407, -200000000
};
