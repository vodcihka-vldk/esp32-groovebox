// Simple test samples for ESP32 Groovebox

#include <stdint.h>

// Snare drum sample (tone + noise)
const uint16_t snare_data_length = 8820; // 0.2 seconds at 44.1kHz
const int16_t snare_data[] = {
    0, 327, 654, 981, 1308, 1634, 1960, 2286, 2611, 2936, 3260, 3584, 3907, 4229, 4551, 4872,
    5193, 5512, 5831, 6149, 6466, 6782, 7097, 7411, 7724, 8036, 8347, 8657, 8966, 9274, 9581, 9887,
    10191, 10494, 10796, 11097, 11396, 11694, 11991, 12286, 12580, 12873, 13164, 13454, 13742, 14029,
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    -2633451, -2639110, -2644775, -2650446, -2656123, -2661806, -2667495, -2673190, -2678891, -2684598
};
